## drivers/soc/oppo/oppo_trace/Kconfig
```kconfig
      config OPPO_DEBUG_ASSERT
      bool "config oppo common software"
	  help
		define this config to get project verion from sharemem.
		Maybe this value is from CDT or dynamic identify by hardware
		id.
```
